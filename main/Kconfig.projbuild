## main/Kconfig.projbuild
```kconfig
menu "Example Configuration"

    config EXAMPLE_BASIC_AUTH
        bool "Basic Authentication"
        default n
        help
            Basic Authentication is a method for an HTTP user agent (e.g. a web browser)
            to provide a user name and password when making a request. It is the simplest
            technique for enforcing access controls to web resources. because it doesn't
            require cookies, session identifiers, or login pages; rather, it uses standard
            fields in the HTTP header.
            Note that, Basic Authentication is not encrypted channel and also easy to retrieve
            credentials as they are sent in plain text format.

    config EXAMPLE_BASIC_AUTH_USERNAME
        string "Basic Authenticate User Name"
        depends on EXAMPLE_BASIC_AUTH
        default "ESP32"
        help
            The client's user name which used for basic authenticate.

    config EXAMPLE_BASIC_AUTH_PASSWORD
        string "Basic Authenticate Password"
        depends on EXAMPLE_BASIC_AUTH
        default "ESP32Webserver"
        help
            The client's password which used for basic authenticate.

    config EXAMPLE_ENABLE_SSE_HANDLER
        bool "Enable Server-Sent Events (SSE) handler"
        default n
        help
            Enable this option to use Server-Sent Events (SSE) functionality.
            This will allow the server to push real-time updates to the client over an HTTP connection.

endmenu

menu "Vigilant Engine Configuration"

    config VE_ENABLE_STATUS_LED
        bool "Enable Status LED"
        default y
        help
            Enable this option to use the status LED functionality in Vigilant Engine.
            The status LED provides visual feedback on the system's status and operations, and can optionally be used for visual output.

    choice VE_STATUS_LED_MODE
        prompt "LED Operation Mode"
        default VE_STATUS_LED_MODE_RGB
        help
            Select how the LED conveys status information.

        config VE_STATUS_LED_MODE_RGB
            bool "RGB (Color-based)"
        
        config VE_STATUS_LED_MODE_BLINK
            bool "BLINK (Frequency-based)"
    endchoice

    # --- RGB Mode Settings ---
    config VE_STATUS_LED_GPIO_RED
        int "Red LED GPIO"
        range 0 64
        default 46
        depends on VE_STATUS_LED_MODE_RGB

    config VE_STATUS_LED_GPIO_GREEN
        int "Green LED GPIO"
        range 0 64
        default 0
        depends on VE_STATUS_LED_MODE_RGB

    config VE_STATUS_LED_GPIO_BLUE
        int "Blue LED GPIO"
        range 0 64
        default 45
        depends on VE_STATUS_LED_MODE_RGB

    # --- BLINK Mode Settings ---
    config VE_STATUS_LED_GPIO_BLINK
        int "Blink LED GPIO"
        range 0 64
        default 48
        depends on VE_STATUS_LED_MODE_BLINK
        
endmenu
```
